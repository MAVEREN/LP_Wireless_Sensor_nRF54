## CMakeLists.txt
```
# SPDX-License-Identifier: MIT

cmake_minimum_required(VERSION 3.20.0)
find_package(Zephyr REQUIRED HINTS $ENV{ZEPHYR_BASE})
project(hub_ble_central)

target_sources(app PRIVATE
    src/main.c
    src/ble_central/scanner.c
    src/ble_central/connection_manager.c
    src/ble_central/gatt_client.c
    src/node_manager/node_manager.c
    src/job_executor/job_executor.c
    src/ipc/ipc_handler.c
    src/storage/storage.c
)

target_include_directories(app PRIVATE 
    src 
    src/ble_central
    src/node_manager
    src/job_executor
    src/ipc
    src/storage
)
```

## prj.conf
```kconfig
# Hub BLE Central Configuration
CONFIG_BT=y
CONFIG_BT_CENTRAL=y
CONFIG_BT_OBSERVER=y
CONFIG_BT_GATT_CLIENT=y
CONFIG_BT_DEVICE_NAME="IndustrialHub"
CONFIG_BT_MAX_CONN=3
CONFIG_LOG=y
CONFIG_SERIAL=y
CONFIG_NVS=y
CONFIG_WATCHDOG=y
CONFIG_PM=y
CONFIG_BOOTLOADER_MCUBOOT=y

# Additional features
CONFIG_UART_ASYNC_API=y
CONFIG_CRC=y
CONFIG_HEAP_MEM_POOL_SIZE=16384
CONFIG_MAIN_STACK_SIZE=2048
CONFIG_SYSTEM_WORKQUEUE_STACK_SIZE=2048
```

## src/main.c
```c
/*
 * Hub BLE Central Main Application
 */

#include <zephyr/kernel.h>
#include <zephyr/device.h>
#include <zephyr/drivers/watchdog.h>
#include <zephyr/bluetooth/bluetooth.h>
#include <zephyr/logging/log.h>

#include "scanner.h"
#include "connection_manager.h"

LOG_MODULE_REGISTER(hub_main, LOG_LEVEL_INF);

typedef enum {
    HUB_STATE_INIT,
    HUB_STATE_SCANNING,
    HUB_STATE_IDLE
} hub_state_t;

static hub_state_t hub_state = HUB_STATE_INIT;

static void scan_callback(const struct bt_le_scan_recv_info *info, 
                         struct net_buf_simple *ad_data)
{
    /* Parse advertisement */
    LOG_DBG("Node advertisement received, RSSI: %d", info->rssi);
}

static struct k_work_delayable scan_work;

static void scan_work_handler(struct k_work *work)
{
    int ret;
    
    LOG_INF("Starting scan cycle");
    hub_state = HUB_STATE_SCANNING;
    
    ret = scanner_start(scan_callback);
    if (ret < 0) {
        LOG_ERR("Scan failed: %d", ret);
        hub_state = HUB_STATE_IDLE;
        k_work_reschedule(&scan_work, K_SECONDS(30));
        return;
    }
    
    k_sleep(K_SECONDS(5));
    scanner_stop();
    
    hub_state = HUB_STATE_IDLE;
    k_work_reschedule(&scan_work, K_SECONDS(30));
}

int main(void)
{
    int ret;
    
    LOG_INF("Hub BLE Central starting...");
    
    ret = bt_enable(NULL);
    if (ret) {
        LOG_ERR("Bluetooth init failed (err %d)", ret);
        return ret;
    }
    
    ret = scanner_init();
    if (ret) {
        LOG_ERR("Scanner init failed");
        return ret;
    }
    
    ret = connection_manager_init();
    if (ret) {
        LOG_ERR("Connection manager init failed");
        return ret;
    }
    
    k_work_init_delayable(&scan_work, scan_work_handler);
    k_work_schedule(&scan_work, K_SECONDS(5));
    
    LOG_INF("Hub BLE Central initialized");
    
    while (1) {
        k_sleep(K_SECONDS(5));
        LOG_DBG("Hub state: %d", hub_state);
    }
    
    return 0;
}
```
